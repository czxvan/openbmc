## meta-fuzz/conf/layer.conf
```bitbake
# We have a conf and classes directory, add to BBPATH
BBPATH .= ":${LAYERDIR}"

# We have recipes-* directories, add to BBFILES
BBFILES += "${LAYERDIR}/recipes-*/*/*.bb \
            ${LAYERDIR}/recipes-*/*/*.bbappend"

BBFILE_COLLECTIONS += "meta-fuzz"
BBFILE_PATTERN_meta-fuzz = "^${LAYERDIR}/"
BBFILE_PRIORITY_meta-fuzz = "6"

LAYERDEPENDS_meta-fuzz = "core"
LAYERSERIES_COMPAT_meta-fuzz = "nanbield scarthgap"
```
